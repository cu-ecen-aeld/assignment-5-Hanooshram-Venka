## base_external/package/ldd/Config.in
```kconfig
config BR2_PACKAGE_LDD
	bool "ldd"
	depends on BR2_LINUX_KERNEL
	help
	  Includes the scull and misc-modules components from the ldd3 repository for Assignment 7.
```
